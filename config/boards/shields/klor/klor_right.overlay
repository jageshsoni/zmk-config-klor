/*
 * Copyright (c) 2022 GEIST
 *
 * SPDX-License-Identifier: MIT
 */

#include "klor.dtsi"

&default_transform {
	col-offset = <6>;
};

&kscan0 {
	col-gpios
		= <&gpio0 009 GPIO_ACTIVE_HIGH>
		, <&gpio0 010 GPIO_ACTIVE_HIGH>
		, <&gpio0 111 GPIO_ACTIVE_HIGH>
		, <&gpio0 113 GPIO_ACTIVE_HIGH>
		, <&gpio0 115 GPIO_ACTIVE_HIGH>
		, <&gpio0 002 GPIO_ACTIVE_HIGH>
		;
};

&right_encoder {
	status = "okay";
};
